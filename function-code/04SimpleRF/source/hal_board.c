/**********************************************************************************************************************************************************
* 文 件 名：hal_board.c
×
* 功    能：
*           通过PCA9554的扩展IO的按键输入变化，对应的PCA9554将输出一个低电平中断，该中断接入CC2530的
*           P0.7端口，进而产生P0中断。在中断服务程序中读取相应的按键值，然后再通过IIC控制另一个PCA9554，
*           即LED的亮灭。
*
*
*
* 版    本：V1.0
* 作    者：WUXIANHAI
* 日    期：2011.1.19
* 奥尔斯科技主页：www.ourselec.com
**********************************************************************************************************************************************************/
#include "hal.h"
#include "hal_mcu.h"
#include "LCD.h"

extern void ctrPCA9554LED(uint8 led,uint8 operation); 
extern void PCA9554ledInit();
extern void ctrPCA9554FLASHLED(uint8 led);   
extern uint8 GetKeyInput();

/**************************************************************************************************
 * 函数名称：Init_IO
 *
 * 功能描述：P0.7中断初始化设置
 *
 * 参    数：无
 *
 * 返 回 值：无
 **************************************************************************************************/
void Init_IO(void)
{
    P0SEL |=0x80;            //将P0.7 设置为外设功能
    P0DIR &=~0x80;           //将P0.7设置为输入
    P0INP &=~0x80;           //端口输入模式设置（P0.7有上拉、下拉）
    P0IEN |=0x80;            //P0.7中断使能
    PICTL |=0x01;            //P0.7为下降沿触发中断       
    EA = 1;                  //使能全局中断
    IEN1 |=0x20;             //P0口中断使能
    P0IFG &= ~0x80;          //P0.7中断标志清0   
};


/**************************************************************************************************
 * 函数名称：P0_IRQ
 *
 * 功能描述：P0口输入中断的中断服务程序。
 *
 * 参    数：无
 *
 * 返 回 值：无
 **************************************************************************************************/
uint8 Keycmd = 0;
#pragma vector=P0INT_VECTOR
__interrupt void P0_IRQ(void)
{
   uint8 key = 0; 
   if ( P0IFG & 0x80)                                      // 若P0.7的中断状态标志位置位
   {     
     key = GetKeyInput();          //读取按键值
     while( ! P0_7 );                                      // 等待用户释放KEY键
     if(key)
     {
      Keycmd = key;
     }

     P0IFG &= ~0x80;                                       // 清零P0.7的中断状态标志位
   }
   INT_SETFLAG(INUM_P0INT, INT_CLR);                       // 清零P0口中断标志
}

/**************************************************************************************************
 * 函数名称：halboardinit
 *
 * 功能描述：初始化主时钟、中断IO、LCD、LED等
 *                     
 *
 * 参    数：无
 *
 * 返 回 值：无
 **************************************************************************************************/
void halboardinit(void)
{ 
  SET_MAIN_CLOCK_SOURCE(CRYSTAL);                          // 设置系统时钟源为32MHz晶体振荡器
  Init_IO();                    //中断初始化
  PCA9554ledInit();             //LED初始化
  
    GUI_Init();                                              // GUI初始化
    GUI_SetColor(1,0);                                       // 显示色为亮点，背景色为暗点
    GUI_PutString5_7(25,6,"OURS-CC2530");                    //显示 OURS-CC2530
    LCM_Refresh();
}

/**************************************************************************************************
 * 函数名称：halkeycmd
 *
 * 功能描述：返回当前按键值
 *                     
 *
 * 参    数：无
 *
 * 返 回 值：key -- 当前按键的值
 **************************************************************************************************/
uint8 halkeycmd(void)
{ 
  uint8 key;
  key = Keycmd;
  if(Keycmd == 4 || Keycmd==5)
  {
   Keycmd = 0;
  }
  return key;
}


