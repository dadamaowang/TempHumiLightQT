/**********************************************************************************************************************************************************
* 文 件 名：P0INT_main.c
×
* 功    能：实验四 P0口输入中断
*           通过PCA9554的扩展IO的按键输入变化，对应的PCA9554将输出一个低电平中断，该中断接入CC2530的
*           P0.7端口，进而产生P0中断。在中断服务程序中读取相应的按键值，然后再通过IIC控制另一个PCA9554，
*           即LED的亮灭。
*
*
* 注    意：本实验所需硬件资源：
*           OURS-CC2530RF模块
*           OURS-CC2530智能电源板或普通电池板。
*
* 版    本：V1.0
* 作    者：WUXIANHAI
* 日    期：2011.1.19
* 奥尔斯科技主页：www.ourselec.com
**********************************************************************************************************************************************************/
#include "ioCC2530.h"
#include "hal_mcu.h"

#define OSC_32KHZ  0x00                //使用外部32K晶体振荡器

//时钟设置函数
#define HAL_BOARD_INIT()                                         \
{                                                                \
  uint16 i;                                                      \
                                                                 \
  SLEEPCMD &= ~OSC_PD;                       /* 开启 16MHz RC 和32MHz XOSC */         \
  while (!(SLEEPSTA & XOSC_STB));            /* 等待 32MHz XOSC 稳定 */               \
  asm("NOP");                                                                         \
  for (i=0; i<504; i++) asm("NOP");          /* 延时63us*/                            \
  CLKCONCMD = (CLKCONCMD_32MHZ | OSC_32KHZ); /* 设置 32MHz XOSC 和 32K 时钟 */        \
  while (CLKCONSTA != (CLKCONCMD_32MHZ | OSC_32KHZ)); /* 等待时钟生效*/               \
  SLEEPCMD |= OSC_PD;                        /* 关闭 16MHz RC */                      \
}

extern void ctrPCA9554LED(uint8 led,uint8 operation); 
extern void PCA9554ledInit();
extern void ctrPCA9554FLASHLED(uint8 led);   
extern uint8 GetKeyInput();

/**************************************************************************************************
 * 函数名称：Init_IO
 *
 * 功能描述：P0.7中断初始化设置
 *
 * 参    数：无
 *
 * 返 回 值：无
 **************************************************************************************************/
void Init_IO(void)
{
    P0SEL |=0x80;            //将P0.7 设置为外设功能
    P0DIR &=~0x80;           //将P0.7设置为输入
    P0INP &=~0x80;           //端口输入模式设置（P0.7有上拉、下拉）
    P0IEN |=0x80;            //P0.7中断使能
    PICTL |=0x01;            //P0.7为下降沿触发中断       
    EA = 1;                  //使能全局中断
    IEN1 |=0x20;             //P0口中断使能
    P0IFG &= ~0x80;          //P0.7中断标志清0   
};


/**************************************************************************************************
 * 函数名称：P0_IRQ
 *
 * 功能描述：P0口输入中断的中断服务程序。
 *
 * 参    数：无
 *
 * 返 回 值：无
 **************************************************************************************************/
#pragma vector=P0INT_VECTOR
__interrupt void P0_IRQ(void)
{ 
     uint8 key = 0;  
     P0IFG &= ~0x80;               //P0.7中断标志清0  
    key = GetKeyInput();          //读取按键值
    if(key)
    {
     ctrPCA9554FLASHLED(key);     //控制相应的LED亮灭
    }    
}

/**************************************************************************************************
 * 函数名称：main
 *
 * 功能描述：初始化时钟和中断口。P0.7的下降沿(按下6个按键中的任意一个)产生P0口输入中断。
 *                     
 *
 * 参    数：无
 *
 * 返 回 值：无
 **************************************************************************************************/
void main(void)
{ 
  HAL_BOARD_INIT();             //初始化时钟
  Init_IO();                    //中断初始化
  PCA9554ledInit();             //LED初始化

  while(1);                     // 死循环，等待P0口下降沿中断(本实验由由P0.7产生)
}




